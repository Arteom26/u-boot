## board/nuvoton/nuc980/Kconfig
```kconfig
if TARGET_NUC980

config SYS_USE_SPIFLASH
    bool "NUC980 SPL Booting via SPI-NAND Flash"
    default n

config SYS_USE_NANDFLASH
    bool "NUC980 SPL Booting via NAND Flash"
    default n

config SYS_BOARD
    default "nuc980"

config SYS_VENDOR
    default "nuvoton"

config SYS_CONFIG_NAME
    default "nuc980"

endif
```

## configs/nuc980_defconfig
```kconfig
CONFIG_ARM=y
CONFIG_NUC980=y
CONFIG_TARGET_NUC980=y

# Device tree config
CONFIG_OF_CONTROL=y
CONFIG_SPL_OF_CONTROL=y
# CONFIG_SPL_OF_PLATDATA=y
CONFIG_OF_PLATDATA_PARENT=y
CONFIG_SPL_OF_PLATDATA_PARENT=y
CONFIG_DEFAULT_DEVICE_TREE="nuvoton-nuc980"

CONFIG_SYS_LOAD_ADDR=0xE00000
CONFIG_TEXT_BASE=0xE00000

# Debug UART Config
CONFIG_DEBUG_UART=y
CONFIG_BAUDRATE=115200
CONFIG_DEBUG_UART_BASE=0xB0070000
CONFIG_DEBUG_UART_CLOCK=12000000

# SPL Configuration
CONFIG_SPL=y
CONFIG_SPL_SEPARATE_BSS=n
CONFIG_SPL_SHARES_INIT_SP_ADDR=n
CONFIG_SPL_STACK=0xBC004000
CONFIG_SPL_TEXT_BASE=0x200
CONFIG_SPL_USE_TINY_PRINTF=n
CONFIG_SPL_LIBCOMMON_SUPPORT=y
CONFIG_SPL_LIBGENERIC_SUPPORT=y
CONFIG_SPL_SPRINTF=y
CONFIG_SYS_USE_SPIFLASH=y
CONFIG_SPL_BSS_MAX_SIZE=0x600
CONFIG_SPL_SHOW_ERRORS=y
# CONFIG_SPL_ENV_SUPPORT=y
# CONFIG_ENV_IS_IN_NAND=y

# CONFIG_MTDIDS_DEFAULT-"nand0=nand0"
# CONFIG_MTDPARTS_DEFAULT="mtdparts=nand0:0x200000@0x0(u-boot),0x1400000@0x200000(kernel),-(user)"

# Setup custom stack pointer address
CONFIG_HAS_CUSTOM_SYS_INIT_SP_ADDR=y
CONFIG_CUSTOM_SYS_INIT_SP_ADDR=0xBC004000

CONFIG_NR_DRAM_BANKS=2

# Driver model Configuration
CONFIG_SPL_DM=y
CONFIG_SIMPLE_BUS=y
CONFIG_SPL_SIMPLE_BUS=y

# Pinctrl Configuration
CONFIG_PINCTRL=y
CONFIG_SPL_PINCTRL=y
CONFIG_PINCTRL_NUC980=y

# NAND Configuration
# CONFIG_MTD=y
# CONFIG_DM_MTD=y
# CONFIG_SPL_MTD=y
# CONFIG_NAND_NUC980=y
# CONFIG_MTD_RAW_NAND=y
# CONFIG_SPL_NAND_SUPPORT=y
# CONFIG_SPL_NAND_DRIVERS=y
# CONFIG_SPL_NAND_RAW_ONLY=y
# CONFIG_SPL_NAND_LOAD=y
# CONFIG_SPL_NAND_SIMPLE=y
# CONFIG_SYS_NAND_U_BOOT_LOCATIONS=y
# CONFIG_SYS_NAND_BLOCK_SIZE=0x20000
# CONFIG_SYS_NAND_U_BOOT_OFFS=0x100000
# CONFIG_MTD_UBI=y
# CONFIG_ENV_OFFSET=0x80000
# CONFIG_ENV_SIZE=0x20000
# CONFIG_ENV_SECT_SIZE=0x20000
# #(4 * CONFIG_ENV_SECT_SIZE)  /* Env range : 0x80000 ~ 0x100000 */
# CONFIG_ENV_RANGE=0x80000
# CONFIG_ENV_OVERWRITE=y


# Console (serial) Configuration
CONFIG_DM_SERIAL=y
CONFIG_SPL_SERIAL=y
CONFIG_SPL_DM_SERIAL=y
CONFIG_NUC980_CONSOLE=y
CONFIG_SYS_CONSOLE_OVERWRITE_ROUTINE=y
CONFIG_CONSOLE_SCROLL_LINES=1
CONFIG_LOG=y
```
